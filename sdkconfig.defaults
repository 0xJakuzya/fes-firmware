## sdkconfig.defaults
```kconfig
# Ethernet (WT32-ETH01, LAN8720, RMII, внешний REF_CLK 50 МГц на GPIO0)
CONFIG_ETH_USE_ESP32_EMAC=y
CONFIG_ETH_PHY_INTERFACE_RMII=y
CONFIG_ETH_RMII_CLK_INPUT=y
CONFIG_ETH_RMII_CLK_IN_GPIO=0

# Логирование
CONFIG_LOG_DEFAULT_LEVEL_INFO=y

# Оптимизация
CONFIG_COMPILER_OPTIMIZATION_PERF=y

# Тик FreeRTOS 1 кГц — для приемлемого джиттера yield в задаче стимуляции
CONFIG_FREERTOS_HZ=1000

# Разделение ядер: Core 1 — реальное время (стимуляция + I2C к платам),
# Core 0 — транспорт (Wi-Fi/LWIP/TCP). Системные задачи прижаты к Core 0,
# чтобы не дёргать 1 мс тик стимуляции на Core 1.
CONFIG_ESP_WIFI_TASK_CORE_ID=0
CONFIG_LWIP_TCPIP_TASK_AFFINITY_CPU0=y
CONFIG_ESP_TIMER_TASK_AFFINITY_0=y
```
